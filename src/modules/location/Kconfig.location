## src/modules/location/Kconfig.location
```kconfig
#
# Copyright (c) 2023 Nordic Semiconductor
#
# SPDX-License-Identifier: LicenseRef-Nordic-5-Clause
#

menu "Location"

config MQTT_SAMPLE_LOCATION_THREAD_STACK_SIZE
	int "Thread stack size"
	default 4096

config MQTT_SAMPLE_LOCATION_GNSS_SLEEP_SECONDS
	int "GNSS sleep period in seconds"
	default 300
	help
	  Time spent with GNSS stopped before it is re-enabled.

module = MQTT_SAMPLE_LOCATION
module-str = Location
source "subsys/logging/Kconfig.template.log_config"

endmenu # Location
```

## src/modules/network/Kconfig.network
```kconfig
#
# Copyright (c) 2023 Nordic Semiconductor
#
# SPDX-License-Identifier: LicenseRef-Nordic-5-Clause
#

menu "Network"
	depends on LTE_CONNECTIVITY || (WIFI_NRF700X && WIFI_MGMT_EXT) || BOARD_NATIVE_POSIX

config MQTT_SAMPLE_NETWORK_THREAD_STACK_SIZE
	int "Thread stack size"
	default 4096

config MQTT_SAMPLE_NETWORK_GNSS_ACTIVE_SECONDS
	int "GNSS active period in seconds"
	default 30
	help
	  Time spent in GNSS mode after a fix before LTE transfer is re-enabled.

config MQTT_SAMPLE_NETWORK_GNSS_INTERVAL_SECONDS
	int "Interval between GNSS sessions in seconds (LTE active duration)"
	default 3600
	help
	  How long the device stays on LTE between GNSS sessions.
	  After this interval, LTE is briefly deactivated to obtain a GNSS fix,
	  then LTE is re-enabled. Default is 3600 (1 hour).

module = MQTT_SAMPLE_NETWORK
module-str = Network
source "subsys/logging/Kconfig.template.log_config"

endmenu # Network
```
