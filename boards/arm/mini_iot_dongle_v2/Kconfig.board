## boards/arm/mini_iot_dongle_v2/Kconfig.board
```kconfig
# Copyright (c) 2024 Nordic Semiconductor ASA
# SPDX-License-Identifier: Apache-2.0

config BOARD_MINI_IOT_DONGLE_V2
	bool "Mini IoT Dongle v2"
	depends on SOC_NRF9160_SICA
```

## boards/arm/mini_iot_dongle_v2/Kconfig.defconfig
```kconfig
# Copyright (c) 2024 Nordic Semiconductor ASA
# SPDX-License-Identifier: Apache-2.0

if BOARD_MINI_IOT_DONGLE_V2

config BOARD
	default "mini_iot_dongle_v2"


endif
```
